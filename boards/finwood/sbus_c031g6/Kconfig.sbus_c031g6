## boards/finwood/sbus_c031g6/Kconfig.sbus_c031g6
```kconfig
# SPDX-License-Identifier: Apache-2.0

config BOARD_SBUS_C031G6
	select SOC_STM32C031XX
```

## boards/finwood/sbus_c031g6/board.yml
```yaml
board:
  name: sbus_c031g6
  full_name: Finwood UART-S.BUS STM32C031G6U6
  vendor: finwood
  socs:
    - name: stm32c031xx
```

## boards/starcopter/sbus_bridge/Kconfig.sbus_bridge
```kconfig
# SPDX-License-Identifier: MIT

config BOARD_SBUS_BRIDGE
	select SOC_STM32C031XX
```

## boards/starcopter/sbus_bridge/board.yml
```yaml
# SPDX-License-Identifier: MIT

board:
  name: sbus_bridge
  full_name: starcopter UART S.BUS Bridge
  vendor: starcopter
  socs:
    - name: stm32c031xx
```

## boards/starcopter/sbus_bridge/sbus_bridge_defconfig
```kconfig
# SPDX-License-Identifier: MIT

# Serial Drivers
CONFIG_SERIAL=y
CONFIG_UART_INTERRUPT_DRIVEN=y
CONFIG_GPIO=y
```

## west.yml
```yaml
manifest:
  self:
    path: .

  remotes:
    - name: zephyrproject-rtos
      url-base: https://github.com/zephyrproject-rtos
    - name: Finwood
      url-base: https://github.com/Finwood

  projects:
    - name: zephyr
      remote: zephyrproject-rtos
      revision: v4.5.0-rc1
      clone-depth: 1
      # remote: Finwood
      # revision: main
      west-commands: scripts/west-commands.yml
      import:
        path-prefix: deps
        name-allowlist:
          - cmsis_6
          - hal_stm32
          - segger
```
